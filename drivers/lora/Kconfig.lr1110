## drivers/lora/Kconfig.lr1110
```kconfig
#
# Copyright (c) 2019 Manivannan Sadhasivam
#
# SPDX-License-Identifier: Apache-2.0
#

menuconfig LORA_LR1110
	bool "Semtech LR1110 driver"
	select HAS_SEMTECH_RADIO_DRIVERS
	select HAS_SEMTECH_LORAMAC
	select HAS_SEMTECH_LR1110
	select HAS_LR1110_SECURE_ELEMENT
	select HAS_LORAMAC_REGION_US915
	select HAS_LORAMAC_REGION_EU868
	select HAS_LORAMAC_ACTIVE_REGION_US915
	depends on SPI
	help
	  Enable LoRa driver for Semtech LR1110.
```
